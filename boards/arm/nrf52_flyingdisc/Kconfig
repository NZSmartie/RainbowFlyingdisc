## boards/arm/nrf52_flyingdisc/Kconfig
```kconfig
# Kconfig - nRF52 Flying Disc board configuration

if BOARD_NRF52_FLYINGDISC

config BOARD_ENABLE_DCDC
	bool "Enable DCDC mode"
	select SOC_DCDC_NRF52X
	default y

endif # BOARD_NRF52_FLYINGDISC
```

## boards/arm/nrf52_flyingdisc/Kconfig.board
```kconfig
# Kconfig - nRF52 Flying Disc board configuration

config  BOARD_NRF52_FLYINGDISC
	bool "nRF52 Flying Disc"
	depends on SOC_NRF52832_QFAA
```

## boards/arm/nrf52_flyingdisc/nrf52_flyingdisc_defconfig
```kconfig
CONFIG_ARM=y
CONFIG_SOC_FAMILY_NRF=y
CONFIG_SOC_SERIES_NRF52X=y
CONFIG_SOC_NRF52832_QFAA=y
CONFIG_BOARD_NRF52_FLYINGDISC=y

# Enable MPU
CONFIG_ARM_MPU_NRF52X=y

# enable uart driver
CONFIG_SERIAL=y
CONFIG_UART_NRFX=y
CONFIG_UART_0_NRF_UART=y

# enable console
CONFIG_CONSOLE=y
CONFIG_UART_CONSOLE=y

# additional board options
CONFIG_GPIO_AS_PINRESET=y

# bluetooth
CONFIG_BT=y
CONFIG_BT_CTLR=y

# Enable Nordic SPI on bus 0
CONFIG_SPI=y
CONFIG_SPI_0_IRQ_PRI=10
CONFIG_SPI_ASYNC=y
CONFIG_SPI_0=y
CONFIG_SPI_NRFX=y
CONFIG_SPI_0_NRF_SCK_PIN=12
CONFIG_SPI_0_NRF_MOSI_PIN=13
CONFIG_SPI_0_NRF_MISO_PIN=14
```
